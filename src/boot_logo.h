#ifndef BOOT_LOGO_H
#define BOOT_LOGO_H

#include <Arduino.h>
#include <LovyanGFX.hpp>

#define BOOT_LOGO_COLS 72
#define BOOT_LOGO_ROWS 46
#define BOOT_LOGO_BYTES_PER_ROW 9
#define BOOT_LOGO_DOT_SIZE 3
#define BOOT_LOGO_CELL_SIZE 4
#define BOOT_LOGO_OFFSET_X 16
#define BOOT_LOGO_OFFSET_Y 28

// Neon cyan-green matching the original ZoneNet phosphor look (RGB: 36, 255, 196)
#define LOGO_COLOR_LIT   0x27F8  // Vibrant Neon Cyan-Green
#define LOGO_COLOR_UNLIT 0x0000  // Black

static const uint8_t PROGMEM logo_base_bitmap[BOOT_LOGO_ROWS][BOOT_LOGO_BYTES_PER_ROW] = {
    { 0x00, 0x00, 0x7C, 0xFF, 0xFF, 0xF3, 0xFF, 0x80, 0x00 },
    { 0x00, 0x00, 0xFC, 0xFF, 0xFF, 0xF3, 0xFF, 0x80, 0x00 },
    { 0x00, 0x00, 0x60, 0x00, 0x00, 0x00, 0xF3, 0x80, 0x00 },
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    { 0xFF, 0x9F, 0xE6, 0x0E, 0x7F, 0xB0, 0x73, 0xFC, 0x18 }
};

static const uint8_t PROGMEM logo_antenna_inner_bitmap[BOOT_LOGO_ROWS][BOOT_LOGO_BYTES_PER_ROW] = {
    { 0x00, 0x00, 0x00, 0x00, 0x00, 0x00, 0x00, 0x00, 0x00 },
    { 0x00, 0x00, 0x00, 0x00, 0x00, 0x00, 0x00, 0x00, 0x00 },
    { 0x00, 0x00, 0x00, 0x00, 0x00, 0x00, 0x00, 0x00, 0x00 },
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    { 0x00, 0x00, 0x00, 0x00, 0x00, 0x00, 0x00, 0x00, 0x00 }
};

static const uint8_t PROGMEM logo_antenna_outer_bitmap[BOOT_LOGO_ROWS][BOOT_LOGO_BYTES_PER_ROW] = {
    { 0x00, 0x00, 0x00, 0x00, 0x00, 0x00, 0x00, 0x00, 0x00 },
    { 0x00, 0x00, 0x00, 0x00, 0x00, 0x00, 0x00, 0x00, 0x00 },
    { 0x00, 0x01, 0x80, 0x00, 0x00, 0x00, 0x00, 0x00, 0x00 },
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    { 0x00, 0x00, 0x00, 0x00, 0x00, 0x00, 0x00, 0x00, 0x00 }
};

// Helper to draw a mask layer with a given color
template <typename T>
static void drawLogoLayer(T& display, const uint8_t mask[BOOT_LOGO_ROWS][BOOT_LOGO_BYTES_PER_ROW], uint16_t color) {
    for (int r = 0; r < BOOT_LOGO_ROWS; ++r) {
        int y = BOOT_LOGO_OFFSET_Y + r * BOOT_LOGO_CELL_SIZE;
        for (int b = 0; b < BOOT_LOGO_BYTES_PER_ROW; ++b) {
            uint8_t byteVal = pgm_read_byte(&mask[r][b]);
            if (!byteVal) continue;
            for (int bit = 0; bit < 8; ++bit) {
                if (byteVal & (0x80 >> bit)) {
                    int c = b * 8 + bit;
                    if (c < BOOT_LOGO_COLS) {
                        int x = BOOT_LOGO_OFFSET_X + c * BOOT_LOGO_CELL_SIZE;
                        display.fillRect(x, y, BOOT_LOGO_DOT_SIZE, BOOT_LOGO_DOT_SIZE, color);
                    }
                }
            }
        }
    }
}

// Plays the 2.5-second ZoneNet boot animation with pulsing/radiating antenna waves
template <typename T>
inline void playZoneNetBootAnimation(T& display) {
    display.fillScreen(LOGO_COLOR_UNLIT);
    display.startWrite();

    // 1. Draw static Base Logo (Z body + ZONENET)
    drawLogoLayer(display, logo_base_bitmap, LOGO_COLOR_LIT);
    display.endWrite();

    unsigned long startTime = millis();
    int animPhase = 0;
    bool prevInner = false;
    bool prevOuter = false;

    // 2. Animate antennas for 2.5 seconds (2500 ms)
    while (millis() - startTime < 2500) {
        // Radiating pulse cycle:
        // Phase 0: Inner wave ON, Outer wave OFF (pulse begins)
        // Phase 1: Inner wave ON, Outer wave ON  (full signal burst)
        // Phase 2: Inner wave OFF, Outer wave ON (wave radiating outward)
        // Phase 3: Both OFF                     (pause between pulses)
        bool innerLit = (animPhase == 0 || animPhase == 1);
        bool outerLit = (animPhase == 1 || animPhase == 2);

        if (innerLit != prevInner || outerLit != prevOuter) {
            display.startWrite();
            if (innerLit != prevInner) {
                drawLogoLayer(display, logo_antenna_inner_bitmap, innerLit ? LOGO_COLOR_LIT : LOGO_COLOR_UNLIT);
                prevInner = innerLit;
            }
            if (outerLit != prevOuter) {
                drawLogoLayer(display, logo_antenna_outer_bitmap, outerLit ? LOGO_COLOR_LIT : LOGO_COLOR_UNLIT);
                prevOuter = outerLit;
            }
            display.endWrite();
        }

        animPhase = (animPhase + 1) % 4;
        delay(90); // ~360ms per pulse cycle -> ~7 full data pulses over 2.5 seconds
    }

    // Ensure antennas are fully lit at the end of boot
    display.startWrite();
    drawLogoLayer(display, logo_antenna_inner_bitmap, LOGO_COLOR_LIT);
    drawLogoLayer(display, logo_antenna_outer_bitmap, LOGO_COLOR_LIT);
    display.endWrite();
    delay(150);
}

#endif // BOOT_LOGO_H
